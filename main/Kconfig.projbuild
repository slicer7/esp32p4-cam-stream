## main/Kconfig.projbuild
```kconfig
menu "P4 Camera Stream Configuration"

    config P4CAM_WIFI_SSID
        string "Wi-Fi SSID"
        default "myssid"

    config P4CAM_WIFI_PASSWORD
        string "Wi-Fi password"
        default "mypassword"

    config P4CAM_WIFI_MAX_RETRY
        int "Maximum Wi-Fi connect retries"
        default 10

    config P4CAM_CSI_SCCB_SDA
        int "Camera SCCB (I2C) SDA GPIO"
        default 7
        help
            GPIO wired to the CSI connector's I2C data line.
            Check your board schematic. Espressif ESP32-P4 boards use GPIO7.

    config P4CAM_CSI_SCCB_SCL
        int "Camera SCCB (I2C) SCL GPIO"
        default 8
        help
            GPIO wired to the CSI connector's I2C clock line.
            Check your board schematic. Espressif ESP32-P4 boards use GPIO8.

    config P4CAM_CSI_RESET_GPIO
        int "Camera RESET GPIO (-1 if not wired)"
        default -1

    config P4CAM_CSI_PWDN_GPIO
        int "Camera POWERDOWN GPIO (-1 if not wired)"
        default -1

    config P4CAM_FRAME_WIDTH
        int "Capture width"
        default 1280

    config P4CAM_FRAME_HEIGHT
        int "Capture height"
        default 960
        help
            Must match one of the OV5647 modes compiled into esp_cam_sensor.
            The firmware logs every supported size at boot; if the requested
            size is rejected it falls back to the sensor default.

            FIELD OF VIEW: only 1280x960 gives the lens's full FOV. The OV5647
            modes differ in how much of the 2624x1954 array they read out, and
            every mode except 1280x960 crops it:

              1280x960   x 24..2600, y 12..1944   98% of the array, 2x2
                         binned. FULL FOV. RAW10, 45 fps. This is the default.
              800x640    x 500..2623, y 0..1953   81% of the width; loses
                         about a fifth of the horizontal FOV.
              1920x1080  x 348..2275, y 434..1521 73% wide, 56% tall. The
                         classic 1080p centre crop, and by far the narrowest
                         view despite being the highest resolution.

            A wider view therefore comes from picking the binned mode, not from
            picking more pixels.

            1280x960 costs more memory than 800x640: 2.4 MB per RGB565 frame
            buffer, two of them, plus a 1.2 MB JPEG output buffer. Expect a
            lower frame rate too - each frame is 2.4x the pixels to encode and
            push over Wi-Fi.

    config P4CAM_JPEG_QUALITY
        int "JPEG quality (1-100)"
        range 1 100
        default 80

    config P4CAM_ISP_BRIGHTNESS
        int "ISP brightness (-128..127, 0 = sensor default)"
        range -128 127
        default 24
        help
            Applied to the ISP at boot via V4L2_CID_BRIGHTNESS on /dev/video20.
            This is a post-ISP lift, not an exposure change: it brightens the
            image without slowing the shutter, so it costs no frame rate but
            will also lift noise in a dark scene. Raise it if the picture is
            dim; set 0 to leave the ISP alone.

    config P4CAM_ISP_CONTRAST
        int "ISP contrast (0..255, 128 = neutral)"
        range 0 255
        default 128

    config P4CAM_ISP_SATURATION
        int "ISP saturation (0..255, 128 = neutral)"
        range 0 255
        default 128

    config P4CAM_DETECT_ENABLE
        bool "Run object detection (YOLO11n, 80 COCO classes)"
        default y
        help
            Runs a YOLO11n model on captured frames using the P4's vector unit.
            Adds about 2.9 MB of model to the app partition and one task; the
            video path is never blocked by it, frames are simply skipped while
            inference is busy.

    config P4CAM_DETECT_INTERVAL_MS
        int "Minimum milliseconds between detections"
        default 400
        depends on P4CAM_DETECT_ENABLE
        help
            Lower runs the model more often and costs more CPU and frame rate.
            Inference itself takes far longer than a frame, so this throttles
            how much of the CPU detection is allowed to consume.

    config P4CAM_DETECT_SCORE_THR
        int "Detection score threshold (percent)"
        range 1 99
        default 40
        depends on P4CAM_DETECT_ENABLE

    config P4CAM_DETECT_DRAW_BOXES
        bool "Draw boxes into the video stream"
        default y
        depends on P4CAM_DETECT_ENABLE
        help
            Boxes are drawn into the frame before JPEG encoding, so they show up
            in ffplay and OpenCV too. Labels are added by the web page from the
            /detections endpoint; turn this off to get a clean image and rely on
            /detections alone.

    choice P4CAM_PIXEL_FORMAT
        prompt "ISP output pixel format fed to the JPEG encoder"
        default P4CAM_FMT_RGB565
        config P4CAM_FMT_RGB565
            bool "RGB565 (2 bytes/pixel, fastest)"
        config P4CAM_FMT_RGB888
            bool "RGB888 (3 bytes/pixel, use if colours look wrong in RGB565)"
    endchoice

endmenu
```
